/* Copyright (c) 2013-2014, The Linux Foundation. All rights reserved.
 *
 * This program is free software; you can redistribute it and/or modify
 * it under the terms of the GNU General Public License version 2 and
 * only version 2 as published by the Free Software Foundation.
 *
 * This program is distributed in the hope that it will be useful,
 * but WITHOUT ANY WARRANTY; without even the implied warranty of
 * MERCHANTABILITY or FITNESS FOR A PARTICULAR PURPOSE.  See the
 * GNU General Public License for more details.
 */

/*---------------------------------------------------------------------------
 * This file is autogenerated file using gcdb parser. Please do not edit it.
 * Update input XML file to add a new entry or update variable in this file
 * VERSION = "1.0"
 *---------------------------------------------------------------------------*/
&mdss_mdp {
	ss_dsi_panel_S6E3FA3_AMS549KU01_FHD: ss_dsi_panel_S6E3FA3_AMS549KU01_FHD {
		qcom,mdss-dsi-panel-name = "ss_dsi_panel_S6E3FA3_AMS549KU01_FHD";
		qcom,mdss-dsi-panel-controller = <&mdss_dsi0>;
		qcom,mdss-dsi-panel-width = <1080>;
		qcom,mdss-dsi-panel-height = <1920>;
		qcom,mdss-dsi-bpp = <24>;
		qcom,mdss-dsi-panel-destination = "display_1";

		qcom,mdss-dsi-panel-timings = [E6 38 26 00 68 6E 2A 46 2C 03 04 00];

		qcom,mdss-dsi-on-command= [
			05 01 00 00 14 00 02 11 00		/* Sleep out, wait 20ms(0x14) */

			/* TE Vsync On */
			29 01 00 00 00 00 02 35 00

			/* AVC setting */
			29 01 00 00 00 00 03 FC 5A 5A
			29 01 00 00 00 00 02 B0 1E
			29 01 00 00 00 00 02 FD B2
			29 01 00 00 00 00 03 FC A5 A5

			/* Brightness condition set */
			29 01 00 00 00 00 03 F0 5A 5A
			29 01 00 00 00 00 24 CA
				01 00 01 00 01 00
				80 80 80
				80 80 80
				80 80 80
				80 80 80
				80 80 80
				80 80 80
				80 80 80
				80 80 80
				00 00 00
				00 00
			29 01 00 00 00 00 03 B2 00 10		/* AID set : AOR 0% */
			29 01 00 00 00 00 03 B6 BC 04		/* CAPS & ELVSS Set */
			29 01 00 00 00 00 02 F7 03		/* Gamma, LTPS(AID) update */
			29 01 00 00 50 00 03 F0 A5 A5		// TEST KEY Disable

			/* Memory Access */
			05 01 00 00 00 00 02 2C 00
			05 01 00 00 00 00 02 3C 00
		];

		qcom,mdss-dsi-off-command=[
			05 01 00 00 0A 00 02 28 00	/* wait 10ms(0x0A) */
			05 01 00 00 96 00 02 10 00	/* wait 150ms(0x96) */
		];

		qcom,cont-splash-enabled;
		qcom,mdss-dsi-force-clk-lane-hs;
		/*qcom,cmd-sync-wait-broadcast;*/
		/*qcom,cmd-sync-wait-trigger;*/
		/*qcom,mdss-dsi-fbc-enable=*/
		/*qcom,mdss-dsi-fbc-bpp=*/
		/*qcom,mdss-dsi-fbc-packing=*/
		/*qcom,mdss-dsi-fbc-quant-error=*/
		/*qcom,mdss-dsi-fbc-bias=*/
		/*qcom,mdss-dsi-fbc-pat-mode=*/
		/*qcom,mdss-dsi-fbc-vlc-mode=*/
		/*qcom,mdss-dsi-fbc-bflc-mode=*/
		/*qcom,mdss-dsi-fbc-h-line-budget=*/
		/*qcom,mdss-dsi-fbc-budget-ctrl=*/
		/*qcom,mdss-dsi-fbc-block-budget=*/
		/*qcom,mdss-dsi-fbc-lossless-threshold=*/
		/*qcom,mdss-dsi-fbc-lossy-threshold=*/
		/*qcom,mdss-dsi-fbc-rgb-threshold=*/
		/*qcom,mdss-dsi-fbc-lossy-mode-idx=*/

		qcom,mdss-dsi-h-back-porch = <32>;
		qcom,mdss-dsi-h-front-porch = <92>;
		qcom,mdss-dsi-h-pulse-width = <16>;
		qcom,mdss-dsi-h-sync-skew = <0>;
		qcom,mdss-dsi-v-back-porch = <7>;
		qcom,mdss-dsi-v-front-porch = <7>;
		qcom,mdss-dsi-v-pulse-width = <2>;

		qcom,mdss-dsi-h-left-border = <0>;
		qcom,mdss-dsi-h-right-border = <0>;
		qcom,mdss-dsi-v-top-border = <0>;
		qcom,mdss-dsi-v-bottom-border = <0>;

		qcom,mdss-dsi-underflow-color = <0xFF>;
		qcom,mdss-dsi-border-color = <0>;

		/*qcom,mdss-dsi-pan-enable-dynamic-fps=*/
		/*qcom,mdss-dsi-pan-fps-update=*/

		qcom,mdss-dsi-bl-pmic-control-type = "bl_ctrl_dcs";
		/*qcom,mdss-dsi-bl-pmic-bank-select=*/
		/*qcom,mdss-dsi-bl-pmic-pwm-frequency=*/
		/*qcom,mdss-dsi-pwm-gpio=*/

		qcom,mdss-dsi-bl-min-level = <0>;
		qcom,mdss-dsi-bl-max-level = <355>;
		qcom,mdss-brightness-max-level = <355>;
		qcom,mdss-dsi-interleave-mode = <0>;
		qcom,mdss-dsi-panel-type = "dsi_cmd_mode";

		qcom,mdss-dsi-te-check-enable;
		qcom,mdss-dsi-te-using-te-pin;
		qcom,mdss-dsi-te-pin-select = <1>;

		qcom,mdss-dsi-te-dcs-command = <1>;
		qcom,mdss-dsi-wr-mem-start = <0x2C>;
		qcom,mdss-dsi-wr-mem-continue = <0x3C>;

		/* CMD mode panel doesn't need below stuff */
		qcom,mdss-dsi-h-sync-pulse= <0>;
		/*qcom,mdss-dsi-hfp-power-mode=*/
		/*qcom,mdss-dsi-hbp-power-mode=*/
		/*qcom,mdss-dsi-hsa-power-mode=*/
		/*qcom,mdss-dsi-last-line-interleave=*/
		qcom,mdss-dsi-bllp-eof-power-mode;
		qcom,mdss-dsi-bllp-power-mode;
		qcom,mdss-dsi-traffic-mode= "burst_mode";

		qcom,mdss-dsi-pixel-packing = "loose";

		qcom,mdss-dsi-virtual-channel-id = <0>;
		qcom,mdss-dsi-color-order = "rgb_swap_rgb";
		qcom,mdss-dsi-lane-0-state;
		qcom,mdss-dsi-lane-1-state;
		qcom,mdss-dsi-lane-2-state;
		qcom,mdss-dsi-lane-3-state;
		qcom,mdss-dsi-lane-map = "lane_map_0123";

		qcom,mdss-dsi-t-clk-pre = <0x2E>;
		qcom,mdss-dsi-t-clk-post = <0x0D>;

		qcom,mdss-dsi-stream = <0>;
		qcom,mdss-dsi-mdp-trigger = "none";
		qcom,mdss-dsi-dma-trigger = "trigger_sw";
		qcom,mdss-dsi-panel-framerate = <60>;
/*		qcom,mdss-dsi-panel-clockrate = <850000000>;*/
		qcom,mdss-dsi-on-command-state = "dsi_lp_mode";
		qcom,mdss-dsi-off-command-state = "dsi_hs_mode";

		qcom,mdss-pan-physical-width-dimension = <69>;
		qcom,mdss-pan-physical-height-dimension = <122>;

		qcom,mdss-dsi-panel-mode-gpio-state = "invalid";

		qcom,mdss-dsi-reset-sequence = <0 5>, <1 10>, <0 10>, <1 10>;

		/* S6E3FA3(LDI) Does not support Partial Update */
		/*qcom,partial-update-enabled;*/
		/*qcom,panel-roi-alignment=<8 8 1 1 1 1>;*/
		/*qcom,mdss-dsi-horizontal-line-idle*/

		qcom,mdss-dsi-lp11-init;
		qcom,mdss-dsi-init-delay-us = <1000>;

		qcom,mdss-dsi-rx-eot-ignore;
		qcom,mdss-dsi-tx-eot-append;

		/*qcom,ulps-enabled*/
		/*qcom,mdss-dsi-panel-status-command=*/
		/*qcom,mdss-dsi-panel-status-command-mode="dsi_lp_mode";*/
		qcom,esd-check-enabled;
		qcom,mdss-dsi-panel-status-check-mode="reg_read_irq";
		qcom,mdss-dsi-panel-status-value = <1>;
		qcom,mdss-dsi-panel-status-irq-trigger1="rising";
		/*qcom,dynamic-mode-switch-enabled*/
		/*qcom,video-to-cmd-mode-switch-commands=*/
		/*qcom,cmd-to-video-mode-switch-commands=*/
/*
 * ************************************************************************************************************************************
 *
 *
 *			Below  parameters are samsung dependent thigs
 *
 *
 * ************************************************************************************************************************************
 */
 		samsung,enter_hbm_lux = <10000>;
		samsung,dsi-lp11-init;

		samsung,display_on_tx_cmds_revA = [05 01 00 00 32 00 02 29 00];
		samsung,display_off_tx_cmds_revA = [05 01 00 00 32 00 02 28 00];

		samsung,level1_key_enable_tx_cmds_revA = [
			29 01 00 00 00 00 03 F0 5A 5A
		];
		samsung,level1_key_disable_tx_cmds_revA = [
			29 01 00 00 00 00 03 F0 A5 A5
		];
		samsung,level2_key_enable_tx_cmds_revA = [
			29 00 00 00 00 00 03 F0 5A 5A
			29 01 00 00 00 00 03 FC 5A 5A
		];
		samsung,level2_key_disable_tx_cmds_revA = [
			29 00 00 00 00 00 03 F0 A5 A5
			29 01 00 00 00 00 03 FC A5 A5
		];

		samsung,packet_size_tx_cmds_revA = [
			37 01 00 00 00 00 02 07 00
		];

		/*
		 * First parameters can be changed
		 * by function of samsung_nv_read()
		 * because of that means offset of
		 * read position
		 */
		samsung,reg_read_pos_tx_cmds_revA = [
			15 01 00 00 00 00 02 B0 00
		];

		/*
		 * ************************************************************************************************************************
		 *	 06 01 00 00 00 00 01 c8 07 21
		 *	READ 0xC8 SIZE 0x07 OFFSET 0x21
		 * ************************************************************************************************************************
		 */
		samsung,smart_dimming_mtp_rx_cmds_revA = [ 06 01 00 00 00 00 01 c8 23 00];
		/* the last byte in all read commands will represent READ LENGH */
		samsung,manufacture_id0_rx_cmds_revA = [ 06 01 00 00 00 00 01 da 01 00];
		samsung,manufacture_id1_rx_cmds_revA = [ 06 01 00 00 00 00 01 db 01 00];
		samsung,manufacture_id2_rx_cmds_revA = [ 06 01 00 00 00 00 01 dc 01 00];

		samsung,manufacture_date_rx_cmds_revA = [ 06 01 00 00 00 00 01 c8 02 28];	/* read C8 41~42th , 40=0x28*/
		samsung,ddi_id_rx_cmds_revA = [ 06 01 00 00 00 00 01 d6 05 00];			/* read D6 1~5th */
		samsung,cell_id_rx_cmds_revA = [ 06 01 00 00 00 00 01 C8 0B 28];		/* read C8 41~51th, 40=0x28 */
		samsung,mtp_read_sysfs_rx_cmds_revA = [ 06 01 00 00 00 00 01 01 01 01];

		samsung,elvss_rx_cmds_revA = [ 06 01 00 00 00 00 01 b6 01 15];			/* read B6 22th , 21=0x15*/
		samsung,mdnie_read_rx_cmds_revA	= [ 06 01 00 00 00 00 01 A1 04 00];

		//samsung,ldi_debug0_rx_cmds_revA = [06 01 00 00 00 00 01 0A 01 00];
		//samsung,ldi_debug1_rx_cmds_revA = [06 01 00 00 00 00 01 0E 01 00];
		//samsung,ldi_debug2_rx_cmds_revA = [06 01 00 00 00 00 01 EA 08 00];
		samsung,hbm_rx_cmds_revA = [ 06 01 00 00 00 00 01 B4 04 00];		/* read B4 1th~4th */
		samsung,hbm2_rx_cmds_revA = [ 06 01 00 00 00 00 01 B4 1D 04];		/* read B4 5th~33th */

		/*
		 * ************************************************************************************************************************
		 *	 COMMON CMD LIST
		 * ************************************************************************************************************************
		 */

		samsung,elvss_lowtemp_tx_cmds_revA = [
			29 01 00 00 00 00 02 B8 19
		];	/* Low Temperature Command */

		samsung,elvss_lowtemp2_tx_cmds_revA = [
			29 01 00 00 00 00 02 B0 15
			29 01 00 00 00 00 02 B6 00
		];	/* Low Temperature Command: default */

		samsung,gamma_tx_cmds_revA = [
			29 01 00 00 00 00 24 CA		/* 1) Gamma 2.2 Setting */
				01 00 01 00 01 00
				80 80 80
				80 80 80
				80 80 80
				80 80 80
				80 80 80
				80 80 80
				80 80 80
				80 80 80
				00 00 00
				00 00
			29 01 00 00 00 00 02 F7 03	/* Gamma, LTPS(AID) update */

			29 01 00 00 00 00 3C		/* dummy for single transmission more 100ns delay */
			00 00 00 00 00 00 00 00 00 00
			00 00 00 00 00 00 00 00 00 00
			00 00 00 00 00 00 00 00 00 00
			00 00 00 00 00 00 00 00 00 00
			00 00 00 00 00 00 00 00 00 00
			00 00 00 00 00 00 00 00 00 00

			29 01 00 00 00 00 02 F7 00
		];

		samsung,hbm_gamma_tx_cmds_revA = [
			29 01 00 00 00 00 24 CA			/* 1) Gamma 2.2 Setting */
				01 00 01 00 01 00
				80 80 80
				80 80 80
				80 80 80
				80 80 80
				80 80 80
				80 80 80
				80 80 80
				80 80 80
				00 00 00
				00 00
			29 01 00 00 00 00 03 B2 00 10		/* AID set : AOR 0% */
			29 01 00 00 00 00 02 F7 03		/* Gamma, LTPS(AID) update */
		];

		samsung,hbm_etc_tx_cmds_revA = [
			29 01 00 00 00 00 03 B6 BC 07		/* HBM ELVSS */
			29 01 00 00 00 00 02 B5 50		/* ACL OPR 32 Frame Average */
			29 01 00 00 00 00 02 53 C0		/* HBM On */
		];

		samsung,hbm_pure_etc_tx_cmds_revA = [
			29 01 00 00 00 00 03 B6 BC 07		/* HBM ELVSS */
			29 01 00 00 00 00 02 B5 50		/* ACL OPR 32 Frame Average */
			29 01 00 00 00 00 02 53 C0		/* HBM On : elvss acl auto*/
		];

		samsung,hbm_off_tx_cmds_revA = [
			29 01 00 00 00 00 02 53 00	/* HBM Off */
		];

		/*
		 * ************************************************************************************************************************
		 * AID command list and mappings
		 * ************************************************************************************************************************
		 */

		samsung,aid_tx_cmds_revA = [ // AOR Setting
			/*	0	*/ 29 01 00 00 00 00 03 B2 70 4C /* 5 CD */
			/*	1	*/ 29 01 00 00 00 00 03 B2 70 42 /* 6 CD */
			/*	2	*/ 29 01 00 00 00 00 03 B2 70 33 /* 7 CD */
			/*	3	*/ 29 01 00 00 00 00 03 B2 70 1E /* 8 CD */
			/*	4	*/ 29 01 00 00 00 00 03 B2 70 14 /* 9 CD */
			/*	5	*/ 29 01 00 00 00 00 03 B2 70 05 /* 10 CD */
			/*	6	*/ 29 01 00 00 00 00 03 B2 60 F6 /* 11 CD */
			/*	7	*/ 29 01 00 00 00 00 03 B2 60 E7 /* 12 CD */
			/*	8	*/ 29 01 00 00 00 00 03 B2 60 D6 /* 13 CD */
			/*	9	*/ 29 01 00 00 00 00 03 B2 60 C8 /* 14 CD */
			/*	10	*/ 29 01 00 00 00 00 03 B2 60 BA /* 15 CD */
			/*	11	*/ 29 01 00 00 00 00 03 B2 60 AB /* 16 CD */
			/*	12	*/ 29 01 00 00 00 00 03 B2 60 A1 /* 17 CD */
			/*	13	*/ 29 01 00 00 00 00 03 B2 60 82 /* 19 CD */
			/*	14	*/ 29 01 00 00 00 00 03 B2 60 6B /* 20 CD */
			/*	15	*/ 29 01 00 00 00 00 03 B2 60 57 /* 21 CD */
			/*	16	*/ 29 01 00 00 00 00 03 B2 60 42 /* 22 CD */
			/*	17	*/ 29 01 00 00 00 00 03 B2 60 0D /* 24 CD */
			/*	18	*/ 29 01 00 00 00 00 03 B2 50 F8 /* 25 CD */
			/*	19	*/ 29 01 00 00 00 00 03 B2 50 CE /* 27 CD */
			/*	20	*/ 29 01 00 00 00 00 03 B2 50 98 /* 29 CD */
			/*	21	*/ 29 01 00 00 00 00 03 B2 50 7A /* 30 CD */
			/*	22	*/ 29 01 00 00 00 00 03 B2 50 44 /* 32 CD */
			/*	23	*/ 29 01 00 00 00 00 03 B2 50 22 /* 34 CD */
			/*	24	*/ 29 01 00 00 00 00 03 B2 40 E4 /* 37 CD */
			/*	25	*/ 29 01 00 00 00 00 03 B2 40 BE /* 39 CD */
			/*	26	*/ 29 01 00 00 00 00 03 B2 40 95 /* 41 CD */
			/*	27	*/ 29 01 00 00 00 00 03 B2 40 56 /* 44 CD */
			/*	28	*/ 29 01 00 00 00 00 03 B2 40 21 /* 47 CD */
			/*	29	*/ 29 01 00 00 00 00 03 B2 30 E3 /* 50 CD */
			/*	30	*/ 29 01 00 00 00 00 03 B2 30 A5 /* 53 CD */
			/*	31	*/ 29 01 00 00 00 00 03 B2 30 64 /* 56 CD */
			/*	32	*/ 29 01 00 00 00 00 03 B2 30 12 /* 60 CD */
			/*	33	*/ 29 01 00 00 00 00 03 B2 20 D5 /* 64 CD */
			/*	34	*/ 29 01 00 00 00 00 03 B2 30 C5 /* 68 CD */
			/*	35	*/ 29 01 00 00 00 00 03 B2 30 C5 /* 72 CD */
			/*	36	*/ 29 01 00 00 00 00 03 B2 20 C5 /* 77 CD */
			/*	37	*/ 29 01 00 00 00 00 03 B2 20 C5 /* 82 CD */
			/*	38	*/ 29 01 00 00 00 00 03 B2 20 C5 /* 87 CD */
			/*	39	*/ 29 01 00 00 00 00 03 B2 20 C5 /* 93 CD */
			/*	40	*/ 29 01 00 00 00 00 03 B2 20 C5 /* 98 CD */
			/*	41	*/ 29 01 00 00 00 00 03 B2 20 C5 /* 105 CD */
			/*	42	*/ 29 01 00 00 00 00 03 B2 20 C5 /* 111 CD */
			/*	43	*/ 29 01 00 00 00 00 03 B2 20 C5 /* 119 CD */
			/*	44	*/ 29 01 00 00 00 00 03 B2 20 C5 /* 126 CD */
			/*	45	*/ 29 01 00 00 00 00 03 B2 20 C5 /* 134 CD */
			/*	46	*/ 29 01 00 00 00 00 03 B2 20 C5 /* 143 CD */
			/*	47	*/ 29 01 00 00 00 00 03 B2 20 C5 /* 152 CD */
			/*	48	*/ 29 01 00 00 00 00 03 B2 20 C5 /* 162 CD */
			/*	49	*/ 29 01 00 00 00 00 03 B2 20 78 /* 172 CD */
			/*	50	*/ 29 01 00 00 00 00 03 B2 20 15 /* 183 CD */
			/*	51	*/ 29 01 00 00 00 00 03 B2 10 B6 /* 195 CD */
			/*	52	*/ 29 01 00 00 00 00 03 B2 10 59 /* 207 CD */
			/*	53	*/ 29 01 00 00 00 00 03 B2 00 F5 /* 220 CD */
			/*	54	*/ 29 01 00 00 00 00 03 B2 00 84 /* 234 CD */
			/*	55	*/ 29 01 00 00 00 00 03 B2 00 10 /* 249 CD */
			/*	56	*/ 29 01 00 00 00 00 03 B2 00 10 /* 265 CD */
			/*	57	*/ 29 01 00 00 00 00 03 B2 00 10 /* 282 CD */
			/*	58	*/ 29 01 00 00 00 00 03 B2 00 10 /* 300 CD */
			/*	59	*/ 29 01 00 00 00 00 03 B2 00 10 /* 316 CD */
			/*	60	*/ 29 01 00 00 00 00 03 B2 00 10 /* 333 CD */
			/*	61	*/ 29 01 00 00 00 00 03 B2 00 10 /* 360 CD */
		];

		/* bl_level, Index in acl command list */
		samsung,aid_map_table_revA = <
			5	0		6	1		7	2		8	3		9	4
			10	5		11	6		12	7		13	8		14	9
			15	10		16	11		17	12		19	13		20	14
			21	15		22	16		24	17		25	18		27	19
			29	20		30	21		32	22		34	23		37	24
			39	25		41	26		44	27		47	28		50	29
			53	30		56	31		60	32		64	33		68	34
			72	35		77	36		82	37		87	38		93	39
			98	40		105	41		111	42		119	43		126	44
			134	45		143	46		152	47		162	48		172	49
			183	50		195	51		207	52		220	53		234	54
			249	55		265	56		282	57		300	58		316	59
			333	60		360	61
		>;

		/*
		 * ************************************************************************************************************************
		 * ACL command list and mappings
		 * ************************************************************************************************************************
		 */

		samsung,acl_on_tx_cmds_revA = [
			29 01 00 00 00 00 02 B5 50	/* ACL 32Frame Averaging */
			29 01 00 00 00 00 02 55 01	// ACL ON : ACL 15%
		];

		samsung,acl_percent_tx_cmds_revA = [
			29 01 00 00 00 00 02 55 00	/* ACL OFF */
			29 01 00 00 00 00 02 55 01
			29 01 00 00 00 00 02 55 02	/* Default ACL */
			29 01 00 00 00 00 02 55 03
		];

		samsung,acl_off_tx_cmds_revA = [
			29 01 00 00 00 00 02 B5 40	/* 16 Frame Avg. */
			29 01 00 00 00 00 02 55 00	/* ACL OFF */
		];

		/* bl_level , Index in acl command list */
		samsung,acl_map_table_revA =  <
			5    2	6    2	7    2	8    2	9    2
			10   2	11   2	12   2	13   2	14   2
			15   2	16   2	17   2	19   2	20   2
			21   2	22   2	24   2	25   2	27   2
			29   2	30   2	32   2	34   2	37   2
			39   2	41   2	44   2	47   2	50   2
			53   2	56   2	60   2	64   2	68   2
			72   2	77   2	82   2	87   2	93   2
			98   2	105  2	111  2	119  2	126  2
			134  2	143  2	152  2	162  2	172  2
			183  2	195  2	207  2	220  2	234  2
			249  2	265  2	282  2	300  2	316  2
			333  2	360  2
		>;

		/*
		 * ************************************************************************************************************************
		 * SMART ACL(ACL On) ELVSS command list and mappings
		 * ************************************************************************************************************************
		 */
		samsung,smart_acl_elvss_tx_cmds_revA = [ // ELVSS Table
			29 01 00 00 00 00 03 B6 AC 07 /* 5 */
			29 01 00 00 00 00 03 B6 AC 07 /* 6 */
			29 01 00 00 00 00 03 B6 AC 07 /* 7 */
			29 01 00 00 00 00 03 B6 AC 07 /* 8 */
			29 01 00 00 00 00 03 B6 AC 07 /* 9 */
			29 01 00 00 00 00 03 B6 AC 07 /* 10 */
			29 01 00 00 00 00 03 B6 AC 07 /* 11 */
			29 01 00 00 00 00 03 B6 AC 07 /* 12 */
			29 01 00 00 00 00 03 B6 AC 07 /* 13 */
			29 01 00 00 00 00 03 B6 AC 07 /* 14 */
			29 01 00 00 00 00 03 B6 AC 07 /* 15 */
			29 01 00 00 00 00 03 B6 AC 07 /* 16 */
			29 01 00 00 00 00 03 B6 AC 07 /* 17 */
			29 01 00 00 00 00 03 B6 AC 07 /* 19 */
			29 01 00 00 00 00 03 B6 AC 07 /* 20 */
			29 01 00 00 00 00 03 B6 AC 09 /* 21 */
			29 01 00 00 00 00 03 B6 AC 0B /* 22 */
			29 01 00 00 00 00 03 B6 AC 0D /* 24 */
			29 01 00 00 00 00 03 B6 AC 0F /* 25 */
			29 01 00 00 00 00 03 B6 AC 11 /* 27 */
			29 01 00 00 00 00 03 B6 AC 13 /* 29 */
			29 01 00 00 00 00 03 B6 AC 15 /* 30 */
			29 01 00 00 00 00 03 B6 AC 17 /* 32 */
			29 01 00 00 00 00 03 B6 AC 1A /* 34 */
			29 01 00 00 00 00 03 B6 AC 1A /* 37 */
			29 01 00 00 00 00 03 B6 AC 1A /* 39 */
			29 01 00 00 00 00 03 B6 BC 1A /* 41 */
			29 01 00 00 00 00 03 B6 BC 1A /* 44 */
			29 01 00 00 00 00 03 B6 BC 1A /* 47 */
			29 01 00 00 00 00 03 B6 BC 1A /* 50 */
			29 01 00 00 00 00 03 B6 BC 1A /* 53 */
			29 01 00 00 00 00 03 B6 BC 1A /* 56 */
			29 01 00 00 00 00 03 B6 BC 1A /* 60 */
			29 01 00 00 00 00 03 B6 BC 1A /* 64 */
			29 01 00 00 00 00 03 B6 BC 1A /* 68 */
			29 01 00 00 00 00 03 B6 BC 1A /* 72 */
			29 01 00 00 00 00 03 B6 BC 1A /* 77 */
			29 01 00 00 00 00 03 B6 BC 19 /* 82 */
			29 01 00 00 00 00 03 B6 BC 19 /* 87 */
			29 01 00 00 00 00 03 B6 BC 19 /* 93 */
			29 01 00 00 00 00 03 B6 BC 19 /* 98 */
			29 01 00 00 00 00 03 B6 BC 18 /* 105 */
			29 01 00 00 00 00 03 B6 BC 18 /* 111 */
			29 01 00 00 00 00 03 B6 BC 17 /* 119 */
			29 01 00 00 00 00 03 B6 BC 17 /* 126 */
			29 01 00 00 00 00 03 B6 BC 17 /* 134 */
			29 01 00 00 00 00 03 B6 BC 17 /* 143 */
			29 01 00 00 00 00 03 B6 BC 16 /* 152 */
			29 01 00 00 00 00 03 B6 BC 15 /* 162 */
			29 01 00 00 00 00 03 B6 BC 14 /* 172 */
			29 01 00 00 00 00 03 B6 BC 14 /* 183 */
			29 01 00 00 00 00 03 B6 BC 13 /* 195 */
			29 01 00 00 00 00 03 B6 BC 12 /* 207 */
			29 01 00 00 00 00 03 B6 BC 11 /* 220 */
			29 01 00 00 00 00 03 B6 BC 10 /* 234 */
			29 01 00 00 00 00 03 B6 BC 0F /* 249 */
			29 01 00 00 00 00 03 B6 BC 0E /* 265 */
			29 01 00 00 00 00 03 B6 BC 0D /* 282 */
			29 01 00 00 00 00 03 B6 BC 0B /* 300 */
			29 01 00 00 00 00 03 B6 BC 0A /* 316 */
			29 01 00 00 00 00 03 B6 BC 09 /* 333 */
			29 01 00 00 00 00 03 B6 BC 07 /* 360 */
		];

		/* bl_level, Index in elvss command list */
		samsung,smart_acl_elvss_map_table_revA = <
			5	0		6	1
			7	2		8	3		9	4		10	5		11	6
			12	7		13	8		14	9		15	10		16	11
			17	12		19	13		20	14		21	15		22	16
			24	17		25	18		27	19		29	20		30	21
			32	22		34	23		37	24		39	25		41	26
			44	27		47	28		50	29		53	30		56	31
			60	32		64	33		68	34		72	35		77	36
			82	37		87	38		93	39		98	40		105	41
			111	42		119	43		126	44		134	45		143	46
			152	47		162	48		172	49		183	50		195	51
			207	52		220	53		234	54		249	55		265	56
			282	57		300	58		316	59		333	60		360	61
		>;

		/*
		 * ************************************************************************************************************************
		 * candela to index mappings
		 * ************************************************************************************************************************
		 */
		samsung,candela_map_table_revA = <
		/*<idx><PMSL range> <candella> *//*linear map*/
				0		0		5		5
				1		6		6		6
				2		7		7		7
				3		8		8		8
				4		9		9		9
				5		10		10		10
				6		11		11		11
				7		12		12		12
				8		13		13		13
				9		14		14		14
				10		15		15		15
				11		16		16		16
				12		17		17		17
				13		18		18		19
				14		19		19		20
				15		20		20		21
				16		21		21		22
				17		22		22		24
				18		23		23		25
				19		24		24		27
				20		25		25		29
				21		26		26		30
				22		27		27		32
				23		28		28		34
				24		29		29		37
				25		30		30		39
				26		31		32		41
				27		33		34		44
				28		35		36		47
				29		37		38		50
				30		39		40		53
				31		41		43		56
				32		44		45		60
				33		46		48		64
				34		49		51		68
				35		52		55		72
				36		56		59		77
				37		60		63		82
				38		64		67		87
				39		68		71		93
				40		71		74		98
				41		75		79		105
				42		80		85		111
				43		86		91		119
				44		92		96		126
				45		97		103		134
				46		104		110		143
				47		111		117		152
				48		118		125		162
				49		126		133		172
				50		134		142		183
				51		143		151		195
				52		152		161		207
				53		162		171		220
				54		172		182		234
				55		183		194		249
				56		195		206		265
				57		207		218		282
				58		219		230		300
				59		231		242		316
				60		243		253		333
				61		254		255		360
		>;

		samsung,hbm_candela_map_table_revA = <
			0	355	355	500	6
		>;
		/*
		* ************************************************************************************************************************
		*  HMT
		* ************************************************************************************************************************
		*/
		samsung,hmt_enabled;
		samsung,hmt_aid_tx_cmds_revA = [
			29 01 00 00 00 00 03 B2 10 84 /* 10 CD */
			29 01 00 00 00 00 03 B2 10 84 /* 11 CD */
			29 01 00 00 00 00 03 B2 10 84 /* 12 CD */
			29 01 00 00 00 00 03 B2 10 84 /* 13 CD */
			29 01 00 00 00 00 03 B2 10 84 /* 14 CD */
			29 01 00 00 00 00 03 B2 10 84 /* 15 CD */
			29 01 00 00 00 00 03 B2 10 84 /* 16 CD */
			29 01 00 00 00 00 03 B2 10 84 /* 17 CD */
			29 01 00 00 00 00 03 B2 10 84 /* 19 CD */
			29 01 00 00 00 00 03 B2 10 84 /* 20 CD */
			29 01 00 00 00 00 03 B2 10 84 /* 21 CD */
			29 01 00 00 00 00 03 B2 10 84 /* 22 CD */
			29 01 00 00 00 00 03 B2 10 84 /* 23 CD */
			29 01 00 00 00 00 03 B2 10 84 /* 25 CD */
			29 01 00 00 00 00 03 B2 10 84 /* 27 CD */
			29 01 00 00 00 00 03 B2 10 84 /* 29 CD */
			29 01 00 00 00 00 03 B2 10 84 /* 31 CD */
			29 01 00 00 00 00 03 B2 10 84 /* 33 CD */
			29 01 00 00 00 00 03 B2 10 84 /* 35 CD */
			29 01 00 00 00 00 03 B2 10 84 /* 37 CD */
			29 01 00 00 00 00 03 B2 10 84 /* 39 CD */
			29 01 00 00 00 00 03 B2 10 84 /* 41 CD */
			29 01 00 00 00 00 03 B2 10 84 /* 44 CD */
			29 01 00 00 00 00 03 B2 10 84 /* 47 CD */
			29 01 00 00 00 00 03 B2 10 84 /* 50 CD */
			29 01 00 00 00 00 03 B2 10 84 /* 50 CD */
			29 01 00 00 00 00 03 B2 10 84 /* 53 CD */
			29 01 00 00 00 00 03 B2 10 84 /* 56 CD */
			29 01 00 00 00 00 03 B2 10 84 /* 60 CD */
			29 01 00 00 00 00 03 B2 10 84 /* 64 CD */
			29 01 00 00 00 00 03 B2 10 84 /* 68 CD */
			29 01 00 00 00 00 03 B2 10 84 /* 72 CD */
			29 01 00 00 00 00 03 B2 20 46 /* 77 CD */
			29 01 00 00 00 00 03 B2 20 46 /* 82 CD */
			29 01 00 00 00 00 03 B2 20 46 /* 87 CD */
			29 01 00 00 00 00 03 B2 20 46 /* 93 CD */
			29 01 00 00 00 00 03 B2 20 46 /* 99 CD */
			29 01 00 00 00 00 03 B2 20 46 /* 105 CD */
		];

		/* bl_level, Index in acl command list */
		samsung,hmt_reverse_aid_map_table_revA = <
			10	0
			11	1
			12	2
			13	3
			14	4
			15	5
			16	6
			17	7
			19	8
			20	9
			21	10
			22	11
			23	12
			25	13
			27	14
			29	15
			31	16
			33	17
			35	18
			37	19
			39	20
			41	21
			44	22
			47	23
			50	24
			53	25
			56	26
			60	27
			64	28
			68	29
			72	30
			77	31
			82	32
			87	33
			93	34
			99	35
			105	36
		>;

		samsung,hmt_candela_map_table_revA = <
		/*<idx>	  <from>  <till> <candella> */
			0	0	6	10
			1	7	13	11
			2	14	20	12
			3	21	27	13
			4	28	34	14
			5	35	41	15
			6	42	48	16
			7	49	55	17
			8	56	62	19
			9	63	69	20
			10	70	76	21
			11	77	83	22
			12	84	90	23
			13	91	97	25
			14	98	104	27
			15	105	111	29
			16	112	118	31
			17	119	125	33
			18	126	132	35
			19	133	139	37
			20	140	146	39
			21	147	153	41
			22	154	160	44
			23	161	167	47
			24	168	174	50
			25	175	181	53
			26	182	188	56
			27	189	195	60
			28	196	202	64
			29	203	209	68
			30	210	216	72
			31	217	223	77
			32	224	230	82
			33	231	237	87
			34	238	244	93
			35	245	251	99
			36	252	255	105
		>;

		samsung,hmt_gamma_tx_cmds_revA = [ // 5.3.1 Dimming For HMD : ???
			29 01 00 00 00 00 24 CA
				01 00 01 00 01 00
				80 80 80
				80 80 80
				80 80 80
				80 80 80
				80 80 80
				80 80 80
				80 80 80
				80 80 80
				00 00 00
				00 00
			29 01 00 00 00 00 03 B2 00 10		// AID set : AOR 0%
			29 01 00 00 00 00 02 F7 03		// Gamma, LTPS(AID) update
		];

		samsung,hmt_elvss_tx_cmds_revA = [
			29 01 00 00 00 00 03 B6 BC 04
		];

		samsung,hmt_enable_tx_cmds_revA = [ // 5.2.1 HMD On Setting
			29 01 00 00 00 00 03 F0 5A 5A
			29 01 00 00 00 00 07 B2 20 46 12 12 12 00		// AOR 70%, AID 1 -Cycle
			29 01 00 00 00 00 03 F0 A5 A5
		];

		samsung,hmt_reverse_tx_cmds_revA = [ // 5.2.2 AID Reverse Setting
			29 01 00 00 00 00 03 F0 5A 5A
			29 01 00 00 00 00 08 F2 01 00 02 5A F0 0C 08		// Reverse Porch Setting
			29 01 00 00 00 00 41 CB 				// LTPS Setting
				28 01 01 01 10 66 88 00
				00 00 0D 00 00 00 00 00
				00 12 6E 00 00 00 00 14
				00 00 00 00 74 00 00 CF
				11 0D 04 05 00 C2 00 00
				00 C0 C0 C0 C0 84 C5 C2
				C0 00 00 00 00 00 00 00
				00 00 00 8C 6E 00 00 14
			29 01 00 00 01 00 02 F7 03
			29 01 00 00 00 00 03 F0 A5 A5
		];

		samsung,hmt_disable_tx_cmds_revA = [ // 5.2.3 HMD OFF Setting
			29 01 00 00 00 00 03 F0 5A 5A
			29 01 00 00 00 00 07 B2 00 10 12 12 12 40 	// AOR 0%, AID 4 -Cycle
			29 01 00 00 01 00 02 F7 03			// Gamma, AID update
			29 01 00 00 00 00 03 F0 A5 A5
		];

		samsung,hmt_forward_tx_cmds_revA = [ // 5.2.4 AID Forawrd Setting
			29 01 00 00 00 00 03 F0 5A 5A
			29 01 00 00 00 00 08 F2 01 00 02 5A F0 09 07	// Porch Setting
			29 01 00 00 00 00 41 CB			// LTPS Setting
				28 01 01 01 10 66 88 00
				00 05 05 00 00 00 00 00
				00 12 6E 00 00 00 00 01
				00 00 00 00 74 00 00 CF
				11 0D 04 05 00 C2 00 00
				00 C0 C0 C0 C0 04 C5 C2
				C0 00 00 00 00 00 00 00
				00 00 00 8C 6E 00 00 01
			29 01 00 00 01 00 02 F7 03
			29 01 00 00 00 00 03 F0 A5 A5
		];
	};
};
