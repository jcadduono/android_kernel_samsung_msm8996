/* Copyright (c) 2014, The Linux Foundation. All rights reserved.
 *
 * This program is free software; you can redistribute it and/or modify
 * it under the terms of the GNU General Public License version 2 and
 * only version 2 as published by the Free Software Foundation.
 *
 * This program is distributed in the hope that it will be useful,
 * but WITHOUT ANY WARRANTY; without even the implied warranty of
 * MERCHANTABILITY or FITNESS FOR A PARTICULAR PURPOSE.  See the
 * GNU General Public License for more details.
 */

&soc {
	sec_thermistor {
		compatible = "samsung,sec-ap-thermistor";
		qcom,therm-vadc = <&pm8994_vadc>;
		status = "okay";
		adc_channel = <115>;
		adc_array = <26068 26112 26162 26212 26262 26312 26361 26434 26507 26581 
				26654 26727 26799 26872 26944 27016 27089 27177 27265 27353
				27441 27529 27628 27727 27826 27925 28024 28138 28251 28365
				28478 28591 28728 28864 29001 29137 29274 29408 29541 29675
				29809 29943 30098 30253 30408 30563 30718 30871 31024 31177
				31330 31483 31700 31916 32133 32350 32567 32779 32991 33204
				33416 33628 33823 34019 34214 34409 34605 34805 35005 35206
				35406 35607 35831 36055 36278 36502 36726 36927 37127 37328
				37528 37729 37917 38104 38292 38479 38667 38839 39010 39182
				39354
				39525 39672 39819 39966 40113 40260 40399 40538 40677 40816
				40955 41094 41233 41372 41511 41650 41728 41776 41824 41875>;

		temp_array = <900 890 880 870 860 850 840 830 820 810
				800 790 780 770 760 750 740 730 720 710
				700 690 680 670 660 650 640 630 620 610
				600 590 580 570 560 550 540 530 520 510
				500 490 480 470 460 450 440 430 420 410
				400 390 380 370 360 350 340 330 320 310
				300 290 280 270 260 250 240 230 220 210
				200 190 180 170 160 150 140 130 120 110
				100 90 80 70 60 50 40 30 20 10
				0
				(-10) (-20) (-30) (-40) (-50) (-60) (-70) (-80) (-90) (-100)
				(-110)(-120)(-130)(-140)(-150)(-160)(-170)(-180)(-190) (-200)>;
	};
};
